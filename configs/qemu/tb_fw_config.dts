/*
 * QEMU Trusted Boot Firmware Configuration.
 * SPDX-License-Identifier: BSD-3-Clause
 */
#include <lib/libc/cdefs.h>

/dts-v1/;

/ {
    secure-partitions {
        compatible = "arm,sp";

#ifdef ARM_BL2_SP_LIST_DTS
        #include __XSTRING(ARM_BL2_SP_LIST_DTS)
#else
#error "ARM_BL2_SP_LIST_DTS must be provided"
#endif
    };
};
